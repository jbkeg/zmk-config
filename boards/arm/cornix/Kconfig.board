## boards/arm/cornix/Kconfig.board
```kconfig
#
# Copyright (c) 2024 The ZMK Contributors
# SPDX-License-Identifier: MIT
#

config BOARD_CORNIX_LEFT
    bool "cornix left"
    depends on SOC_NRF52840_QIAA

config BOARD_CORNIX_RIGHT
    bool "cornix right"
    depends on SOC_NRF52840_QIAA
```

## boards/arm/eyelash_corne/Kconfig.eyelash_corne_left
```kconfig
# eyelash_corne_left board configuration
config BOARD_EYELASH_CORNE_LEFT
    select SOC_SERIES_NRF52X
    select SOC_NRF52840_QIAA
    imply RETAINED_MEM
    imply RETENTION
    imply RETENTION_BOOT_MODE
```

## boards/arm/eyelash_corne/Kconfig.eyelash_corne_right
```kconfig
# eyelash_corne_right board configuration
config BOARD_EYELASH_CORNE_RIGHT
    select SOC_SERIES_NRF52X
    select SOC_NRF52840_QIAA
    imply RETAINED_MEM
    imply RETENTION
    imply RETENTION_BOOT_MODE
```

## boards/arm/eyelash_corne/board.yml
```yaml
boards:
  - name: eyelash_corne_left
    vendor: jzf
    revision:
      format: major.minor.patch
      default: 1.0.0
      revisions:
        - name: 1.0.0
  - name: eyelash_corne_right
    vendor: jzf
    revision:
      format: major.minor.patch
      default: 1.0.0
      revisions:
        - name: 1.0.0
```

## boards/arm/eyelash_sofle/Kconfig.eyelash_sofle_left
```kconfig
# eyelash_sofle_left board configuration
config BOARD_EYELASH_SOFLE_LEFT
    select SOC_SERIES_NRF52X
    select SOC_NRF52840_QIAA
    imply RETAINED_MEM
    imply RETENTION
    imply RETENTION_BOOT_MODE
```

## boards/arm/eyelash_sofle/Kconfig.eyelash_sofle_right
```kconfig
# eyelash_sofle_right board configuration
config BOARD_EYELASH_SOFLE_RIGHT
    select SOC_SERIES_NRF52X
    select SOC_NRF52840_QIAA
    imply RETAINED_MEM
    imply RETENTION
    imply RETENTION_BOOT_MODE
```

## boards/arm/eyelash_sofle/board.yml
```yaml
boards:
  - name: eyelash_sofle_left
    vendor: jzf
    revision:
      format: major.minor.patch
      default: 1.0.0
      revisions:
        - name: 1.0.0
  - name: eyelash_sofle_right
    vendor: jzf
    revision:
      format: major.minor.patch
      default: 1.0.0
      revisions:
        - name: 1.0.0
```

## boards/arm/eyelash_sofle/eyelash_sofle_right_defconfig
```kconfig
# Enable 32kHz crystal
CONFIG_CLOCK_CONTROL_NRF_K32SRC_XTAL=y
CONFIG_CLOCK_CONTROL_NRF_K32SRC_30PPM=y

# Enable MPU
CONFIG_ARM_MPU=y

# enable pinctrl
CONFIG_PINCTRL=y

# enable GPIO
CONFIG_GPIO=y

# Enable SPI
CONFIG_SPI=y

# Enable writing to flash
CONFIG_USE_DT_CODE_PARTITION=y
CONFIG_BUILD_OUTPUT_UF2=y
CONFIG_MPU_ALLOW_FLASH_WRITE=y
CONFIG_NVS=y
CONFIG_SETTINGS_NVS=y
CONFIG_FLASH=y
CONFIG_FLASH_PAGE_LAYOUT=y
CONFIG_FLASH_MAP=y

#EXT POWER
CONFIG_ZMK_EXT_POWER=y

# Underglow defaults for split-side builds.
CONFIG_ZMK_RGB_UNDERGLOW=y
CONFIG_ZMK_RGB_UNDERGLOW_EXT_POWER=n
CONFIG_ZMK_RGB_UNDERGLOW_ON_START=n
CONFIG_ZMK_RGB_UNDERGLOW_BRT_MAX=90
CONFIG_ZMK_RGB_UNDERGLOW_AUTO_OFF_IDLE=y
CONFIG_ZMK_RGB_UNDERGLOW_AUTO_OFF_USB=y
CONFIG_ZMK_RGB_UNDERGLOW_HUE_START=160
CONFIG_ZMK_RGB_UNDERGLOW_EFF_START=3
```

## config/west.yml
```yaml
manifest:
  defaults:
    revision: v0.3
  remotes:
    - name: zmkfirmware
      url-base: https://github.com/zmkfirmware
    # Additional modules containing boards/shields/custom code can be listed here as well
    # See https://docs.zephyrproject.org/3.2.0/develop/west/manifest.html#projects
    - name: urob
      url-base: https://github.com/urob

    - name: englmaxi
      url-base: https://github.com/englmaxi
    - name: carrefinho
      url-base: https://github.com/carrefinho
    - name: janpfischer
      url-base: https://github.com/janpfischer
    - name: togura
      url-base: https://github.com/t-ogura

    - name: caksoylar
      url-base: https://github.com/caksoylar

    - name: mctechnology17
      url-base: https://github.com/mctechnology17
    - name: m165437
      url-base: https://github.com/M165437
    - name: zzeneg
      url-base: https://github.com/zzeneg
    - name: srwi
      url-base: https://github.com/srwi
  projects:
    - name: zmk
      remote: zmkfirmware
      import: app/west.yml

    ## Urob's ZMK modules
    - name: zmk-adaptive-key
      path: modules/zmk/adaptive-key
      remote: urob
    - name: zmk-auto-layer
      path: modules/zmk/auto-layer
      remote: urob
    - name: zmk-helpers
      path: modules/zmk/helpers
      remote: urob
    - name: zmk-leader-key
      path: modules/zmk/leader-key
      remote: urob
    - name: zmk-tri-state
      path: modules/zmk/tri-state
      remote: urob
    - name: zmk-unicode
      path: modules/zmk/unicode
      remote: urob

    ## ZMK Dongle Display
    - name: zmk-dongle-display
      remote: englmaxi

    ## Prospector Dongle
    - name: prospector-zmk-module
      remote: carrefinho
      revision: main

    ## Yet Another Dongle Screen(YADS)
    - name: zmk-dongle-screen
      remote: janpfischer
      revision: main

    ## RGB LED Widget
    - name: zmk-rgbled-widget
      remote: caksoylar

    ## KeyPeek support
    - name: zmk-raw-hid
      remote: zzeneg
      revision: main
    - name: zmk-keypeek-layer-notifier
      remote: srwi
      revision: master

    ## NiceView Widget Modules
    - name: zmk-nice-oled
      remote: mctechnology17
      revision: main
    - name: zmk-dongle-display-view
      remote: mctechnology17
      revision: main
    - name: zmk-oled-adapter
      remote: mctechnology17
      revision: main
    - name: nice-view-gem
      remote: m165437
      revision: v0.3.0
  self:
    path: config
```
