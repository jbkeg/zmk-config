## boards/arm/eyelash_corne/Kconfig.board
```kconfig
#
# Copyright (c) 2024 The ZMK Contributors
# SPDX-License-Identifier: MIT
#

config BOARD_EYELASH_CORNE_LEFT
    bool "eyelash_corne left"
    depends on SOC_NRF52840_QIAA

config BOARD_EYELASH_CORNE_RIGHT
    bool "eyelash_corne right"
    depends on SOC_NRF52840_QIAA
```

## boards/shields/delta_omega/Kconfig.defconfig
```kconfig
if SHIELD_DELTA_OMEGA_LEFT

config ZMK_KEYBOARD_NAME
    default "Delta Omega"

config ZMK_SPLIT_ROLE_CENTRAL
    default y

endif

if SHIELD_DELTA_OMEGA_LEFT || SHIELD_DELTA_OMEGA_RIGHT

config ZMK_SPLIT
    default y

endif
```

## boards/shields/delta_omega/Kconfig.shield
```kconfig
config SHIELD_DELTA_OMEGA_LEFT
    def_bool $(shields_list_contains,delta_omega_left)

config SHIELD_DELTA_OMEGA_RIGHT
    def_bool $(shields_list_contains,delta_omega_right)
```
