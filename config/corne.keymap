#define CONFIG_WIRELESS

#define ZMK_BASE_LAYER(name, LT, RT, LM, RM, LB, RB, LH, RH)                   \
    ZMK_LAYER(                                                                 \
        name,                                                                  \
        &none       LT  RT   &none                                             \
        &none       LM  RM   &none                                             \
        &kp ESC     LB  RB   &kp BSPC                                          \
        &kp ENTER   LH  RH   &kp SPACE                                         \
    )

#include "continuum/matrix/42.h"
#include "continuum/base.keymap"
