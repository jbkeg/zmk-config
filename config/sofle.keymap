#define CONFIG_WIRELESS
    
#define NUMBER_ROW &kp GRAVE  &kp N1  &kp N2  &kp N3  &kp N4  &kp N5  &kp N6  &kp N7  &kp N8  &kp N9  &kp N0  &none

#define ZMK_BASE_LAYER(name, LT, RT, LM, RM, LB, RB, LH, RH)                                                    \
    ZMK_LAYER(                                                                                                  \
        name,                                                                                                   \
        NUMBER_ROW                                                                                              \
        &none      LT                                                                          RT        &none  \
        &none      LM                                                                          RM        &none  \
        &none      LB                  LEC_BINDING(&kp C_MUTE)  REC_BINDING(&none)             RB        &none  \
        &none      &kp ESC  &kp ENTER  LH                       RH                  &kp SPACE  &kp BSPC  &none, \
        SENSOR_VOLUME_BINDING  SENSOR_SCROLL_BINDING                                                            \
    )

#include "continuum/utils/encoders.h"
#include "continuum/matrix/sofle.h"
#include "continuum/base.keymap"
