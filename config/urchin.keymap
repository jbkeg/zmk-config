#define CONFIG_WIRELESS

#define ZMK_BASE_LAYER(name, LT, RT, LM, RM, LB, RB, LH, RH)                   \
    ZMK_LAYER(                                                                 \
        name,                                                                  \
          LT  RT                                                               \
          LM  RM                                                               \
          LB  RB                                                               \
          LH  RH                                                               \
    )

#include "continuum/matrix/totem.h"
#include "continuum/base.keymap"
